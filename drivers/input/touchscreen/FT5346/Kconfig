## drivers/input/touchscreen/FT5346/Kconfig
```kconfig
config TOUCHSCREEN_FT5346
	bool "FOCALTECH FT5346 touchpanel driver"
	depends on CONFIG_INPUT_TOUCHSCREEN
	default n
```

## drivers/input/touchscreen/ft5336/Kconfig
```kconfig
config TOUCHSCREEN_FT5336
	bool "FOCALTECH FT5336 touchpanel driver"
	depends on CONFIG_INPUT_TOUCHSCREEN
	default n
```
